## boards/shields/microdix/Kconfig.defconfig
```kconfig
if SHIELD_MICRODIX_RIGHT

config ZMK_KEYBOARD_NAME
	default "Microdix-TP"

config ZMK_SPLIT_ROLE_CENTRAL
	default y
endif

if SHIELD_MICRODIX_LEFT || SHIELD_MICRODIX_RIGHT

config ZMK_SPLIT
	default y
endif
```

## config/boards/shields/microdix/Kconfig.shield
```kconfig
# Copyright (c) 2020 The ZMK Contributors
# SPDX-License-Identifier: MIT

config SHIELD_MICRODIX_LEFT
	def_bool $(shields_list_contains,microdix_left)

config SHIELD_MICRODIX_RIGHT
	def_bool $(shields_list_contains,microdix_right)
```

## config/west.yml
```yaml
manifest:
  remotes:
    - name: zmkfirmware
      url-base: https://github.com/zmkfirmware
    - name: infused-kim
      url-base: https://github.com/infused-kim
    - name: petejohanson
      url-base: https://github.com/petejohanson
    - name: urob
      url-base: https://github.com/urob
    - name: badjeff
      url-base: https://github.com/badjeff/

  projects:
    - name: zmk
      remote: infused-kim
      revision: pr-testing/mouse_ps2_module_base
      import: app/west.yml

    #
    # Additional zmk modules
    #

    # Module for PS/2 mouse & TP driver
    - name: kb_zmk_ps2_mouse_trackpoint_driver
      remote: infused-kim
      revision: main

    # Badjeff's input listener that can turn mouse movement
    # into scroll movement
    - name: zmk-input-behavior-listener
      remote: badjeff
      revision: main

    # Urob's zmk helpers that contain key position defines
    - name: zmk-helpers
      remote: urob
      revision: v2 # this will eventually become main

  self:
    path: config
```
